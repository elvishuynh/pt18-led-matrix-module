## Kconfig
```kconfig
config PT18_MATRIX
	bool "PT18 LED Matrix Middleware"
	default n
	depends on TM1640
	help
	  Enable the PT18 LED V0 matrix middleware library. Provides a
	  17-column logical framebuffer and handles the hardware-specific
	  mapping to the TM1640 16-grid physical layout.

if PT18_MATRIX
rsource "lib/pt18_matrix/Kconfig"
endif
```

## boards/shields/pt18_led_v0/Kconfig.defconfig
```kconfig
if SHIELD_PT18_LED_V0

config TM1640
	default y

config PT18_MATRIX
	default y

config PT18_MATRIX_TEXT
	default y

endif
```

## lib/pt18_matrix/Kconfig
```kconfig
config PT18_MATRIX_TEXT
	bool "PT18 Matrix text rendering support"
	default y
	depends on PT18_MATRIX
	help
	  Enable 5x7 font text rendering for the PT18 LED V0 matrix.
	  Provides pt18_matrix_print() for scrolling ASCII text.
```
